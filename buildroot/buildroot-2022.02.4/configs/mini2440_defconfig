## buildroot/buildroot-2022.02.4/configs/mini2440_defconfig
```kconfig
BR2_arm=y
BR2_arm920t=y
BR2_JLEVEL=16
BR2_TOOLCHAIN_EXTERNAL=y
BR2_TOOLCHAIN_EXTERNAL_CUSTOM=y
BR2_TOOLCHAIN_EXTERNAL_DOWNLOAD=y
BR2_TOOLCHAIN_EXTERNAL_URL="file://$(TOPDIR)/../../toolchains/arm-mini2440-linux-gnueabi_sdk-buildroot.tar.gz"
BR2_TOOLCHAIN_EXTERNAL_CUSTOM_PREFIX="arm-mini2440-linux-gnueabi"
BR2_TOOLCHAIN_EXTERNAL_GCC_6=y
BR2_TOOLCHAIN_EXTERNAL_HEADERS_5_16=y
BR2_TOOLCHAIN_EXTERNAL_CUSTOM_GLIBC=y
# BR2_TOOLCHAIN_EXTERNAL_INET_RPC is not set
BR2_TARGET_GENERIC_HOSTNAME="mini2440"
BR2_TARGET_GENERIC_ISSUE="Welcome to Mini2440"
BR2_ROOTFS_DEVICE_CREATION_DYNAMIC_MDEV=y
BR2_TARGET_GENERIC_GETTY_PORT="ttySAC0"
# BR2_PACKAGE_URANDOM_SCRIPTS is not set
BR2_TARGET_ROOTFS_EXT2=y
BR2_TARGET_ROOTFS_EXT2_4=y
BR2_TARGET_ROOTFS_TAR_BZIP2=y
```

## buildroot/buildroot-2022.02.4/configs/mini2440_toochain_defconfig
```kconfig
BR2_arm=y
BR2_arm920t=y
BR2_JLEVEL=16
BR2_TOOLCHAIN_BUILDROOT_VENDOR="mini2440"
BR2_TOOLCHAIN_BUILDROOT_GLIBC=y
BR2_KERNEL_HEADERS_VERSION=y
BR2_DEFAULT_KERNEL_VERSION="5.18.19"
BR2_GCC_VERSION_6_X=y
BR2_TARGET_GENERIC_HOSTNAME="mini2440"
BR2_TARGET_GENERIC_ISSUE="Welcome to Mini2440"
BR2_INIT_NONE=y
BR2_SYSTEM_BIN_SH_NONE=y
# BR2_TARGET_GENERIC_GETTY is not set
# BR2_PACKAGE_BUSYBOX is not set
# BR2_TARGET_ROOTFS_TAR is not set
```

## u-boot/u-boot-2016.11/configs/mini2440_defconfig
```kconfig
CONFIG_ARM=y
CONFIG_TARGET_MINI2440=y
CONFIG_BOOTDELAY=3
# CONFIG_DISPLAY_BOARDINFO is not set
CONFIG_HUSH_PARSER=y
CONFIG_SYS_PROMPT="MINI2440 # "
# CONFIG_CMD_ELF is not set
# CONFIG_CMD_IMI is not set
# CONFIG_CMD_IMLS is not set
# CONFIG_CMD_XIMG is not set
# CONFIG_CMD_FPGA is not set
# CONFIG_CMD_ITEST is not set
# CONFIG_CMD_SOURCE is not set
# CONFIG_CMD_SETEXPR is not set
CONFIG_CMD_DHCP=y
CONFIG_CMD_PING=y
CONFIG_CMD_CACHE=y
# CONFIG_CMD_MISC is not set
CONFIG_MTD_UBI=y
# CONFIG_USE_PRIVATE_LIBGCC is not set
# CONFIG_REGEX is not set
```
